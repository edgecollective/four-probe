#include <Arduino.h>
#include "Adafruit_ZeroTimer.h" // https://github.com/dwblair/Adafruit_ZeroTimer

uint8_t  sine_wave[256] = {
  0x80, 0x83, 0x86, 0x89, 0x8C, 0x90, 0x93, 0x96,
  0x99, 0x9C, 0x9F, 0xA2, 0xA5, 0xA8, 0xAB, 0xAE,
  0xB1, 0xB3, 0xB6, 0xB9, 0xBC, 0xBF, 0xC1, 0xC4,
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  0x67, 0x6A, 0x6D, 0x70, 0x74, 0x77, 0x7A, 0x7D
};

volatile uint8_t t = 0;


float freq4 = 10000; // 10 Hz


Adafruit_ZeroTimer zt4 = Adafruit_ZeroTimer(4);

void TC4_Handler(){
  Adafruit_ZeroTimer::timerHandler(4);
}


void Timer4Callback0()
{

t++;
  
}

void setup() {

analogWriteResolution(8);

  analogReadResolution(12);


  // for timer 4 ---------------------------------------

  
  //Serial.println("Timer callback tester");

  //Serial.print("Desired freq4 (Hz):");
  //Serial.println(freq4);

   // Set up the flexible divider/compare
  uint8_t divider  = 1;
  uint16_t compare = 0;
  tc_clock_prescaler prescaler = TC_CLOCK_PRESCALER_DIV1;


  if ((freq4 < 24000000) && (freq4 > 800)) {
    divider = 1;
    prescaler = TC_CLOCK_PRESCALER_DIV1;
    compare = 48000000/freq4;
  } else if (freq4 > 400) {
    divider = 2;
    prescaler = TC_CLOCK_PRESCALER_DIV2;
    compare = (48000000/2)/freq4;
  } else if (freq4 > 200) {
    divider = 4;
    prescaler = TC_CLOCK_PRESCALER_DIV4;
    compare = (48000000/4)/freq4;
  } else if (freq4 > 100) {
    divider = 8;
    prescaler = TC_CLOCK_PRESCALER_DIV8;
    compare = (48000000/8)/freq4;
  } else if (freq4 > 50) {
    divider = 16;
    prescaler = TC_CLOCK_PRESCALER_DIV16;
    compare = (48000000/16)/freq4;
  } else if (freq4 > 12) {
    divider = 64;
    prescaler = TC_CLOCK_PRESCALER_DIV64;
    compare = (48000000/64)/freq4;
  } else if (freq4 > 3) {
    divider = 256;
    prescaler = TC_CLOCK_PRESCALER_DIV256;
    compare = (48000000/256)/freq4;
  } else if (freq4 >= 0.75) {
    divider = 1024;
    prescaler = TC_CLOCK_PRESCALER_DIV1024;
    compare = (48000000/1024)/freq4;
  } else {
    Serial.println("Invalid freq4uency");
    while (1) delay(10);
  }

  //Serial.println("Timer 4:");
 // Serial.print("Divider:"); Serial.println(divider);
 // Serial.print("Compare:"); Serial.println(compare);
 // Serial.print("Final freq4:"); Serial.println((int)(48000000/compare));

  zt4.enable(false);
  zt4.configure(prescaler,       // prescaler
          TC_COUNTER_SIZE_16BIT,       // bit width of timer/counter
          TC_WAVE_GENERATION_MATCH_PWM // freq3uency or PWM mode
          );

  zt4.setCompare(0, compare);
  zt4.setCallback(true, TC_CALLBACK_CC_CHANNEL0, Timer4Callback0);
  zt4.enable(true);

  
}

void loop() {
analogWrite(A0, sine_wave[t]);
}
